## config/boards/shields/crfkb/Kconfig.defconfig
```kconfig
# Copyright (c) 2020 The ZMK Contributors
# SPDX-License-Identifier: MIT

if SHIELD_CRFKB_LEFT

config ZMK_KEYBOARD_NAME
	default "CRFKB"

config ZMK_SPLIT_BLE_ROLE_CENTRAL
	default y

endif

if SHIELD_CRFKB_RIGHT

config ZMK_KEYBOARD_NAME
	default "CRFKB_Right"

endif

if SHIELD_CRFKB_RIGHT || SHIELD_CRFKB_LEFT

config ZMK_SPLIT
	default y

endif
```

## config/boards/shields/crfkb/Kconfig.shield
```kconfig
# Copyright (c) 2020 The ZMK Contributors
# SPDX-License-Identifier: MIT

config SHIELD_CRFKB_LEFT
	def_bool $(shields_list_contains,crfkb_left)

config SHIELD_CRFKB_RIGHT
	def_bool $(shields_list_contains,crfkb_right)
```
